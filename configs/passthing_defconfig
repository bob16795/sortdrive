## configs/passthing_defconfig
```kconfig
BR2_arm=y
BR2_arm1176jzf_s=y
BR2_PACKAGE_HOST_LINUX_HEADERS_CUSTOM_4_19=y
BR2_TOOLCHAIN_BUILDROOT_WCHAR=y
BR2_TOOLCHAIN_BUILDROOT_CXX=y
BR2_TARGET_GENERIC_HOSTNAME="passthing"
BR2_TARGET_GENERIC_ISSUE="hello"
BR2_TARGET_GENERIC_ROOT_PASSWD="default"
BR2_ROOTFS_OVERLAY="board/passthing/rootfs_overlay"
BR2_ROOTFS_POST_BUILD_SCRIPT="board/passthing/post-build.sh"
BR2_ROOTFS_POST_IMAGE_SCRIPT="board/passthing/post-image.sh"
BR2_ROOTFS_POST_SCRIPT_ARGS="--add-pi3-miniuart-bt-overlay"
BR2_LINUX_KERNEL=y
BR2_LINUX_KERNEL_CUSTOM_GIT=y
BR2_LINUX_KERNEL_CUSTOM_REPO_URL="http://github.com/raspberrypi/linux"
BR2_LINUX_KERNEL_CUSTOM_REPO_VERSION="rpi-4.19.y"
BR2_LINUX_KERNEL_USE_ARCH_DEFAULT_CONFIG=y
BR2_LINUX_KERNEL_DTS_SUPPORT=y
BR2_LINUX_KERNEL_INTREE_DTS_NAME="bcm2708-rpi-zero-w"
BR2_PACKAGE_BUSYBOX_SHOW_OTHERS=y
BR2_PACKAGE_DIRECTFB=y
BR2_PACKAGE_SDL=y
BR2_PACKAGE_SDL2=y
BR2_PACKAGE_SDL2_DIRECTFB=y
BR2_PACKAGE_RPI_FIRMWARE=y
BR2_PACKAGE_RNG_TOOLS=y
BR2_PACKAGE_PYTHON=y
BR2_PACKAGE_PYTHON_CURSES=y
BR2_PACKAGE_PYTHON_LUMAOLED=y
BR2_PACKAGE_PYTHON_RPI_GPIO=y
BR2_PACKAGE_NCURSES_TARGET_PROGS=y
BR2_PACKAGE_PCRE=y
BR2_PACKAGE_OPENSSH=y
BR2_PACKAGE_BASH=y
BR2_PACKAGE_VIM=y
BR2_TARGET_ROOTFS_EXT2=y
BR2_TARGET_ROOTFS_EXT2_4=y
BR2_TARGET_ROOTFS_EXT2_SIZE="120M"
# BR2_TARGET_ROOTFS_TAR is not set
BR2_PACKAGE_HOST_DOSFSTOOLS=y
BR2_PACKAGE_HOST_GENIMAGE=y
BR2_PACKAGE_HOST_MTOOLS=y
```

## package/fbcat/Config.in
```kconfig
config BR2_PACKAGE_FBCAT
	bool "fbcat"
	help
	  FBGrab is a framebuffer screenshot program, capturing the
	  linux frambuffer and converting it to a png-picture.

	  http://fbgrab.monells.se/
```

## package/python-adafruit-gpio/Config.in
```kconfig
config BR2_PACKAGE_PYTHON_ADAFRUIT_GPIO
	bool "python-adafruit-gpio"
	select BR2_PACKAGE_PYTHON_ADAFRUIT_PUREIO # runtime
	select BR2_PACKAGE_PYTHON_SPIDEV # runtime
	help
	  Library to provide a cross-platform GPIO interface on the
	  Raspberry Pi and Beaglebone Black using the RPi.GPIO and
	  Adafruit_BBIO libraries.

	  https://github.com/adafruit/Adafruit_Python_GPIO/
```

## package/python-adafruit-ssd1306/Config.in
```kconfig
config BR2_PACKAGE_PYTHON_ADAFRUIT_SSD1306
	bool "python-adafruit-ssd1306"
	select BR2_PACKAGE_PYTHON_ADAFRUIT_GPIO # runtime
	help
	  Python library to use SSD1306-based 128x64 or 128x32 pixel
	  OLED displays with a Raspberry Pi or Beaglebone Black.

	  https://github.com/adafruit/Adafruit_Python_SSD1306/
```

## package/python-luma/python-pillow/Config.in
```kconfig
config BR2_PACKAGE_PYTHON_PILLOW
	bool "python-pillow"
	help
	  Python Imaging Library (Fork).

	  https://python-pillow.org
```

## package/python-lumacore/Config.in
```kconfig
config BR2_PACKAGE_PYTHON_LUMACORE
	bool "python-lumacore"
	select BR2_PACKAGE_PYTHON_PILLOW # runtime
	select BR2_PACKAGE_PYTHON_SMBUS2 # runtime
	select BR2_PACKAGE_PYTHON_PYFTDI # runtime
	help
	  A component library to support SBC display drivers.

	  https://github.com/rm-hull/luma.core
```
